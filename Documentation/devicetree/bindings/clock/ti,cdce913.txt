## Documentation/devicetree/bindings/clock/ti,cdce913.txt
```
Binding for Texas Instruments CDCE(L)913 programmable I2C clock generators.

Reference
This binding uses the common clock binding[1]. Details about the devices can be
found in the data sheet[2].

[1] Documentation/devicetree/bindings/clock/clock-bindings.txt
[2] CDCE(L)913 Data Sheet: http://www.ti.com/lit/ds/symlink/cdce913.pdf

Required properties:
 - compatible: One of "ti,cdce913", "ti,cdcel913"
 - reg: I2C device address.
 - #clock-cells: From common clock bindings: Shall be 1.

Optional properties:
 - clock-output-names: From common clock bindings.
 - clock-frequency: Tuple of requested output frequencies <Y1, Y2, Y3>
 - ti,s0: State of the S0 config pin. Shall be 0 or 1.
 - ti,crystal-load-capacity: Value for the internal capacitor. Valid values
   range from 0 to 20 (inclusive).
 - ti,input-clock-type: Type of input clock. One of 'xtal, 'VCXO', 'LVCMOS'

Example:
	cdce913@65 {
	        #clock-cells = <1>;
	        clocks = <&xtal>;
		clock-frequency = <25000000>, <50000000>, <100000000>;
	        compatible = "ti,cdce913";
	        reg = <0x65>;
	        ti,s0 = <1>;
	        ti,input-clock-type = "xtal";
	};
```

## Documentation/devicetree/bindings/drm/xilinx/cresample.txt
```
Device-Tree bindings for Xilinx Chroma Resampler(CRESAMPLE)

Xilinx CRESAMPLE provides the chroma resampling of YUV formats.

Required properties:
 - compatible: value should be "xlnx,v-cresample-4.0"
 - reg: base address and size of the CRESAMPLE IP
 - xlnx,input-format: the input video format of CRESAMPLE
 - xlnx,output-format: the output video format of CRESAMPLE

Example:

	v_cresample_0: v-cresample@40020000 {
		compatible = "xlnx,v-cresample-4.0";
		reg = <0x40020000 0x10000>;
		xlnx,input-format = <0>;
		xlnx,output-format = <1>;
	};
```

## Documentation/devicetree/bindings/drm/xilinx/rgb2ycrcb.txt
```
Device-Tree bindings for Xilinx RGB to YCrCb convertor(RGB2YCRCB)

Xilinx RGB2YCRCB converts the pixel format from RGB to YCrCb

Required properties:
 - compatible: value should be "xlnx,v-rgb2ycrcb-7.0"
 - reg: base address and size of the RGB2YCRCB IP

Example:

	v_rgb2ycrcb_0: v-rgb2ycrcb@40030000 {
		compatible = "xlnx,v-rgb2ycrcb-7.0";
		reg = <0x40030000 0x10000>;
	};
```

## Documentation/devicetree/bindings/media/xilinx/xlnx,axi-ccm.txt
```
Xilinx Color Correction Matrix (CCM)
------------------------------------

Required properties:

- compatible: Must be "xlnx,axi-ccm".

- reg: Physical base address and length of the registers set for the device.

- ports: Video ports, using the DT bindings defined in ../video-interfaces.txt.
  The ccm has an input port (0) and an output port (1).

Required port properties:

- xlnx,axi-video-format, xlnx,axi-video-width: Video format and width, as
  defined in video.txt.

Example:

	axi_ccm_0: axi_ccm {
		compatible = "xlnx,axi-ccm";
		reg = <0x400c0000 0x10000>;

		ports {
			#address-cells = <1>;
			#size-cells = <0>;

			port@0 {
				reg = <0>;

				xlnx,axi-video-format = "rgb";
				xlnx,axi-video-width = <8>;

				ccm0_in: endpoint {
					remote-endpoint = <&cfa0_out>;
				};
			};
			port@1 {
				reg = <1>;

				xlnx,axi-video-format = "rgb";
				xlnx,axi-video-width = <8>;

				ccm0_out: endpoint {
					remote-endpoint = <&gamma0_in>;
				};
			};
		};
	};
```

## Documentation/devicetree/bindings/media/xilinx/xlnx,axi-enhance.txt
```
Xilinx Image Enhance (ENHANCE)
------------------------------------

Required properties:

- compatible: Must be "xlnx,axi-enhance".

- reg: Physical base address and length of the registers set for the device.

- ports: Video ports, using the DT bindings defined in ../video-interfaces.txt.
  The enhance as an input port (0) and and output port (1).

Required port properties:

- xlnx,axi-video-format, xlnx,axi-video-width: Video format and width, as
  defined in video.txt.

Example:

	axi_enhance_0: axi_enhance {
		compatible = "xlnx,axi-enhance";
		reg = <0x40110000 0x10000>;
		ports {
			#address-cells = <1>;
			#size-cells = <0>;

			port@0 {
				reg = <0>;

				xlnx,axi-video-format = "yuv422";
				xlnx,axi-video-width = <8>;

				enhance0_in: endpoint {
					remote-endpoint = <&rgb2yuv0_out>;
				};
			};
			port@1 {
				reg = <1>;

				xlnx,axi-video-format = "yuv422";
				xlnx,axi-video-width = <8>;

				enhance0_out: endpoint {
					remote-endpoint = <&cresample0_in>;
				};
			};
		};
	};
```

## Documentation/devicetree/bindings/media/xilinx/xlnx,axi-gamma.txt
```
Xilinx Gamma Correction (GAMMA)
------------------------------------

Required properties:

- compatible: Must be "xlnx,axi-gamma".

- reg: Physical base address and length of the registers set for the device.

- ports: Video ports, using the DT bindings defined in ../video-interfaces.txt.
  The gamma has an input port (0) and an output port (1).

Required port properties:

- xlnx,axi-video-format, xlnx,axi-video-width: Video format and width, as
  defined in video.txt.

Example:

	axi_gamma_0: axi_gamma {
		compatible = "xlnx,axi-gamma";
		reg = <0x400d0000 0x10000>;
		ports {
			#address-cells = <1>;
			#size-cells = <0>;

			port@0 {
				reg = <0>;

				xlnx,axi-video-format = "rgb";
				xlnx,axi-video-width = <8>;

				gamma0_in: endpoint {
					remote-endpoint = <&gamma0_out>;
				};
			};
			port@1 {
				reg = <1>;

				xlnx,axi-video-format = "rgb";
				xlnx,axi-video-width = <8>;

				gamma0_out: endpoint {
					remote-endpoint = <&rgb2yuv0_in>;
				};
			};
		};
	};
```

## Documentation/devicetree/bindings/media/xilinx/xlnx,axi-scaler.txt
```
Xilinx Scaler (SCALER)
------------------------------------

Required properties:

- compatible: Must be "xlnx,axi-scaler".

- reg: Physical base address and length of the registers set for the device.

- xlnx,num-hori-taps, xlnx,num-vert-taps: The number of horizontal and vertical
  taps for scaling filter(range: 2 - 12).

- xlnx,max-num-phases: The maximum number of phases for scaling filter
  (range: 2 - 64).

- xlnx,separate-yc-coef, xlnx,separate-hv-coef: The boolean flag to specify
  if coefficients are shared between between Luma(Y) and Chroma(C) or between
  horizontal and vertical filters.

- ports: Video ports, using the DT bindings defined in ../video-interfaces.txt.
  The scaler has an input port (0) and an output port (1).

Required port properties:

- xlnx,axi-video-format, xlnx,axi-video-width: Video format and width, as
  defined in video.txt.

Example:

	axi_scaler_0: axi_scaler {
		compatible = "xlnx,axi-scaler";
		reg = <0x43c30000 0x10000>;

		xlnx,num-hori-taps = <12>;
		xlnx,num-vert-taps = <12>;
		xlnx,max-num-phases = <4>;
		xlnx,separate-hv-coef;

		ports {
			#address-cells = <1>;
			#size-cells = <0>;

			port@0 {
				reg = <0>;

				xlnx,axi-video-format = "yuv422";
				xlnx,axi-video-width = <8>;

				scaler0_in: endpoint {
					remote-endpoint = <&cresample0_out>;
				};
			};
			port@1 {
				reg = <1>;

				xlnx,axi-video-format = "yuv422";
				xlnx,axi-video-width = <8>;

				scaler0_out: endpoint {
					remote-endpoint = <&vcap0_in>;
				};
			};
		};
	};
```

## Documentation/devicetree/bindings/media/xilinx/xlnx,axi-spc.txt
```
Xilinx Spatial Pixel Correction (SPC)
------------------------------------

Required properties:

- compatible: Must be "xlnx,axi-spc".

- reg: Physical base address and length of the registers set for the device.

- xlnx,axi-video-width: Video pixel component width, as defined in video.txt.

- ports: Video ports, using the DT bindings defined in ../video-interfaces.txt.
  The spc as an input port (0) and and output port (1).

Example:

	axi_spc_0: axi_spc {
		compatible = "xlnx,axi-spc";
		reg = <0x400a0000 0x10000>;

		xlnx,axi-video-width = <8>;

		ports {
			#address-cells = <1>;
			#size-cells = <0>;

			port@0 {
				reg = <0>;
				spc0_in: endpoint {
					remote-endpoint = <&tpg0_out>;
				};
			};
			port@1 {
				reg = <1>;
				spc0_out: endpoint {
					remote-endpoint = <&cfa0_in>;
				};
			};
		};
	};
```

## Documentation/devicetree/bindings/media/xilinx/xlnx,axi-stats.txt
```
Xilinx Image Statistics (STATS)
-------------------------------

Required properties:

- compatible: Must be "xlnx,axi-stats".

- reg: Physical base address and length of the registers set for the device.

- ports: Video ports, using the DT bindings defined in ../video-interfaces.txt.
  The stats has an input port (0) and an output port (1).

Required port properties:

- xlnx,axi-video-format, xlnx,axi-video-width: Video format and width, as
  defined in video.txt.

Example:

	axi_stats_0: axi_stats {
		compatible = "xlnx,axi-stats";
		reg = <0x40120000 0x10000>;
		ports {
			#address-cells = <1>;
			#size-cells = <0>;

			port@0 {
				reg = <0>;

				xlnx,axi-video-format = "rgb";
				xlnx,axi-video-width = <8>;

				stats0_in: endpoint {
					remote-endpoint = <&cfa0_out>;
				};
			};
			port@1 {
				reg = <1>;

				xlnx,axi-video-format = "rgb";
				xlnx,axi-video-width = <8>;

				stats0_out: endpoint {
					remote-endpoint = <&ccm0_in>;
				};
			};
		};
	};
```

## drivers/gpu/drm/xilinx/Kconfig
```kconfig
config DRM_XILINX
	tristate "DRM Support for Xilinx"
	depends on DRM  && ARCH_ZYNQ
	select DRM_KMS_HELPER
	select DRM_KMS_CMA_HELPER
	select DRM_KMS_GEM_HELPER
	select SI570
	select XILINX_AXIVDMA
```

## drivers/gpu/drm/zynq/Kconfig
```kconfig
config DRM_ZYNQ
	tristate "DRM Support for Xilinx Zynq"
	depends on DRM  && ARCH_ZYNQ
	select DRM_KMS_HELPER
	select DRM_KMS_CMA_HELPER
	select DRM_KMS_GEM_HELPER
	select SI570
	select XILINX_AXIVDMA
```

## drivers/media/platform/xilinx/Kconfig
```kconfig
config VIDEO_XILINX
	tristate "Xilinx Video IP (EXPERIMENTAL)"
	depends on VIDEO_V4L2 && VIDEO_V4L2_SUBDEV_API && OF && EXPERIMENTAL
	---help---
	  Driver for Xilinx Video IP Pipelines

if VIDEO_XILINX

endif #VIDEO_XILINX
```
